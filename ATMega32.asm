INCLUDE "M32DEF.INC"
.ORG $50
W: // WEIGHTS
.ORG $280
I:
.DB 0, 0, 0, 0, 0, 0, 0, 0, 0, 0
.DB 0, 0, 1, 1, 1, 1, 1, 1, 0, 0
.DB 0, 0, 1, 0, 0, 0, 0, 0, 0, 0
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.DB 0, 0, 0, 0, 0, 0, 0, 0, 0, 0
 .ORG $0
LDI R20,100
LDI R21,11
LDI R19,1
LDI R22,0
LDI YL,LOW(W<<1)
LDI YH,HIGH(W<<1)
LDI XL,LOW(I<<1)
LDI XH,HIGH(I<<1)
BACK:
MOV ZL,YL
MOV ZH,YH
LPM R16,Z
CLC
ADD YL,R19
BRBC 0,SKIP
INC YH
SKIP:
MOV ZL,XL
MOV ZH,XH
LPM R17,Z
INC XL
SBRS R17,0
RJMP CHECK
ADD R18,R16
RJMP CHECK
CHECK:
DEC R20
BREQ C1
RJMP BACK
C1:
DEC R21
BREQ HERE
MOV XL,R22
LDI XH,0 
ST X,R18
CLR R18
INC R22
LDI XL,LOW(I<<1)
LDI XH,HIGH(I<<1)
LDI R20,100
RJMP BACK 
HERE:
LDI R16,$FF
OUT DDRA,R16
LDI R17,11
LDI XH,$0
LDI XL,$0
LDI R20,0
LDI R18,0
LDI R21,-1
L:
DEC R17
BREQ EXIT
LD R19,X+
INC R21
SBRC R19,7
RJMP L
MOV R20,R18
SUB R20,R19
BRCS MAXI
BRNE L
MAXI:
OUT PORTA,R21
MOV R18,R19
RJMP L
EXIT: RJMP EXIT